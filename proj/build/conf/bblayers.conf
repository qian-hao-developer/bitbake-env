## proj/build/conf/bblayers.conf
```bitbake
BBPATH := "${TOPDIR}"
BBFILES ?= ""
BBLAYERS = "\
    ${TOPDIR}/../meta \
    ${TOPDIR}/../meta-test \
    "
```

## proj/meta/conf/layer.conf
```bitbake
BBPATH .= ":${LAYERDIR}"
BBFILES += "\
    ${LAYERDIR}/recipe-*/*/*.bb \
    ${LAYERDIR}/recipe-*/*/*.bbappend \
    "
```
